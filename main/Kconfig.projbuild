## main/Kconfig.projbuild
```kconfig
menu "Tac Photo: Storage (SD Card) Configuration"

config STORAGE_PIN_MOSI
    int "MOSI pin for SD card (SPI)"
    default 11

config STORAGE_PIN_MISO
    int "MISO pin for SD card (SPI)"
    default 13

config STORAGE_PIN_CLK
    int "CLK pin for SD card (SPI)"
    default 12

config STORAGE_PIN_CS
    int "CS pin for SD card (SPI)"
    default -1

config STORAGE_I2C_SCL
    int "I2C SCL pin for CH422G control"
    default 9

config STORAGE_I2C_SDA
    int "I2C SDA pin for CH422G control"
    default 8

endmenu
```
